## CMakeLists.txt
```
# SPDX-License-Identifier: Apache-2.0

cmake_minimum_required(VERSION 3.13.1)

set(BOARD bbc_microbit)
set(SHIELD element14_minode)

include($ENV{ZEPHYR_BASE}/cmake/app/boilerplate.cmake NO_POLICY_SCOPE)
project(minode_example)

# target_sources(app PRIVATE src/switch_example.c)
# target_sources(app PRIVATE src/light_example.c)
# target_sources(app PRIVATE src/rotary_example.c)
# target_sources(app PRIVATE src/sound_example.c)
target_sources(app PRIVATE src/dht11_example.c)
```

## sample.yaml
```
sample:
  name: element14 minode Examples
tests:
  sample.board.bbc_microbit.display:
    platform_whitelist: bbc_microbit
    tags: minode examples
```

## prj.conf
```kconfig
# nothing here
CONFIG_GPIO=y
CONFIG_DISPLAY=y
CONFIG_MICROBIT_DISPLAY=y
CONFIG_UART_CONSOLE=y

CONFIG_MAIN_STACK_SIZE=1024
CONFIG_IDLE_STACK_SIZE=320
CONFIG_SYSTEM_WORKQUEUE_STACK_SIZE=1024
CONFIG_ISR_STACK_SIZE=1024

CONFIG_ELEMENT14_MINODE_LIB=y
CONFIG_ELEMENT14_MINODE_LIB_SWITCH=y
CONFIG_ELEMENT14_MINODE_LIB_LIGHT_SENSOR=y
CONFIG_ELEMENT14_MINODE_LIB_ROTARY=y

CONFIG_ELEMENT14_MINODE_LIB_SOUND_SENSOR=y
# CONFIG_ELEMENT14_MINODE_LIB_SOUND_SENSOR_SAMPLINGS_COUNT=3
# CONFIG_ELEMENT14_MINODE_LIB_SOUND_SENSOR_SAMPLINGS_PERIOD_MS=15
# CONFIG_ELEMENT14_MINODE_LIB_SOUND_SENSOR_NOISE_HIGHEST_FREQ_HZ=10000
# CONFIG_ELEMENT14_MINODE_LIB_SOUND_SENSOR_NOISE_LOWEST_AMPLITUDE_ADC_VAL=80
# CONFIG_HEAP_MEM_POOL_SIZE=256

CONFIG_ADC=y
CONFIG_NRFX_ADC=y
CONFIG_ADC_0=y
CONFIG_ADC_NRFX_ADC=y
CONFIG_ADC_NRFX_ADC_CHANNEL_COUNT=3

CONFIG_ELEMENT14_MINODE_LIB_DHT11=y
```

## src/dht11_example.c
```c
/*
 * Copyright (c) 2017 Intel Corporation
 *
 * SPDX-License-Identifier: Apache-2.0
 */

#include <zephyr.h>
#include <sys/printk.h>
#include <device.h>

#include <display/mb_display.h>
#include <minode.h>

#define DHT_SENSOR_NAME(id) _CONCAT(dht_, id)
#define DHT_SENSOR_DEV(id)  (&DHT_SENSOR_NAME(id))
#define DHT_SENSOR_DEVICE_DEFINE(id, connector)                             \
				MINODE_DHT_DEVICE_DEFINE(DHT_SENSOR_NAME(id), _CONCAT(A, id),       \
				STRINGIFY(id),                                                      \
				on_new_sampling)


void on_new_sampling(struct minode_dht_device *dev)
{
  const char *id = dev->user_data;
  struct mb_display *disp = mb_display_get();
  struct sensor_value temp_data;

  minode_dht_ambient_temp_get(dev, &temp_data);
  printk("DHT11[%s] attached on %s new sampling - ambient_temp: %d\n", id,
      dev->connector, temp_data.val1);

  mb_display_print(disp, MB_DISPLAY_MODE_SCROLL, K_SECONDS(2), "%d", temp_data.val1);
}

DHT_SENSOR_DEVICE_DEFINE(0, A0);

void main(void)
{
	struct mb_display *disp = mb_display_get();

  printk("mi:node DHT11 sensor example starting.\n");
	minode_dht_init(DHT_SENSOR_DEV(0));
  minode_dht_start_sampling(DHT_SENSOR_DEV(0), 5000);
}
```

## src/light_example.c
```c
/*
 * Copyright (c) 2017 Intel Corporation
 *
 * SPDX-License-Identifier: Apache-2.0
 */

#include <zephyr.h>
#include <sys/printk.h>
#include <device.h>

#include <display/mb_display.h>
#include <minode.h>

#define LIGHT_NAME(id) _CONCAT(light_, id)
#define LIGHT_DEV(id)  (&LIGHT_NAME(id))
#define LIGHT_DEVICE_DEFINE(id, connector)                           \
				MINODE_LIGHT_DEVICE_DEFINE(LIGHT_NAME(id), _CONCAT(A, id),   \
				STRINGIFY(id),                                               \
				light_on_level_change)

static struct mb_image lighting[] = {

  MB_IMAGE({ 0, 0, 0, 0, 0 },
					 { 0, 0, 0, 0, 0 },
					 { 0, 0, 0, 0, 0 },
					 { 0, 0, 0, 0, 0 },
					 { 0, 0, 0, 0, 0 }),

  MB_IMAGE({ 0, 0, 0, 0, 0 },
					 { 0, 0, 0, 0, 0 },
					 { 0, 0, 1, 0, 0 },
					 { 0, 0, 0, 0, 0 },
					 { 0, 0, 0, 0, 0 }),

  MB_IMAGE({ 0, 0, 0, 0, 0 },
					 { 0, 0, 0, 0, 0 },
					 { 0, 1, 1, 1, 0 },
					 { 0, 0, 0, 0, 0 },
					 { 0, 0, 0, 0, 0 }),

  MB_IMAGE({ 0, 0, 0, 0, 0 },
					 { 0, 1, 1, 1, 0 },
					 { 0, 1, 1, 1, 0 },
					 { 0, 1, 1, 1, 0 },
					 { 0, 0, 0, 0, 0 }),

  MB_IMAGE({ 1, 1, 1, 1, 1 },
					 { 1, 1, 1, 1, 1 },
					 { 1, 1, 1, 1, 1 },
					 { 1, 1, 1, 1, 1 },
					 { 1, 1, 1, 1, 1 }),
};

void display_on(enum minode_light_level level)
{
  int index;
	struct mb_display *disp = mb_display_get();

  index = (int)level;
  if(index < MINODE_LIGHT_LEVEL_0 || index > MINODE_LIGHT_LEVEL_4) {
    return;
  }
  mb_display_image(disp, MB_DISPLAY_MODE_SINGLE,
      K_FOREVER, &lighting[index], 1);
}

void light_on_level_change(struct minode_light_device *dev,
        enum minode_light_level prev_level, enum minode_light_level new_level)
{
  const char *id = dev->user_data;
  printk("Light[%s] attached on %s level changed: prev_level=%d, new_level=%d.\n", id,
      dev->connector, prev_level, new_level);
  display_on(new_level);
}

LIGHT_DEVICE_DEFINE(0, A0);

void main(void)
{
  enum minode_light_level level;
	struct mb_display *disp = mb_display_get();

  printk("mi:node Light example starting.\n");

	minode_light_init(LIGHT_DEV(0));
  level = minode_light_get_level(LIGHT_DEV(0));
  display_on(level);
  minode_light_start_listening(LIGHT_DEV(0));
}
```

## src/rotary_example.c
```c
/*
 * Copyright (c) 2017 Intel Corporation
 *
 * SPDX-License-Identifier: Apache-2.0
 */

#include <zephyr.h>
#include <sys/printk.h>
#include <device.h>

#include <display/mb_display.h>
#include <minode.h>

#define ROTARY_NAME(id) _CONCAT(rotary_, id)
#define ROTARY_DEV(id)  (&ROTARY_NAME(id))
#define ROTARY_DEVICE_DEFINE(id, connector)                           \
				MINODE_ROTARY_DEVICE_DEFINE(ROTARY_NAME(id), _CONCAT(A, id),   \
				STRINGIFY(id),                                               \
				rotary_on_level_change)

static struct mb_image lighting[] = {

  MB_IMAGE({ 0, 0, 0, 0, 0 },
					 { 0, 0, 0, 0, 0 },
					 { 0, 0, 0, 0, 0 },
					 { 0, 0, 0, 0, 0 },
					 { 0, 0, 0, 0, 0 }),

  MB_IMAGE({ 0, 0, 0, 0, 0 },
					 { 0, 0, 0, 0, 0 },
					 { 0, 0, 1, 0, 0 },
					 { 0, 0, 0, 0, 0 },
					 { 0, 0, 0, 0, 0 }),

  MB_IMAGE({ 0, 0, 0, 0, 0 },
					 { 0, 0, 0, 0, 0 },
					 { 0, 1, 1, 1, 0 },
					 { 0, 0, 0, 0, 0 },
					 { 0, 0, 0, 0, 0 }),

  MB_IMAGE({ 0, 0, 0, 0, 0 },
					 { 0, 1, 1, 1, 0 },
					 { 0, 1, 1, 1, 0 },
					 { 0, 1, 1, 1, 0 },
					 { 0, 0, 0, 0, 0 }),

  MB_IMAGE({ 1, 1, 1, 1, 1 },
					 { 1, 1, 1, 1, 1 },
					 { 1, 1, 1, 1, 1 },
					 { 1, 1, 1, 1, 1 },
					 { 1, 1, 1, 1, 1 }),
};

void display_on(enum minode_rotary_level level)
{
  int index;
	struct mb_display *disp = mb_display_get();

  index = (int)level;
  if(index < MINODE_ROTARY_LEVEL_0 || index > MINODE_ROTARY_LEVEL_9) {
    return;
  }
  index = index / 2;
  mb_display_image(disp, MB_DISPLAY_MODE_SINGLE,
      K_FOREVER, &lighting[index], 1);
}

void rotary_on_level_change(struct minode_rotary_device *dev,
        enum minode_rotary_level prev_level, enum minode_rotary_level new_level)
{
  const char *id = dev->user_data;
  printk("Light[%s] attached on %s level changed: prev_level=%d, new_level=%d.\n", id,
      dev->connector, prev_level, new_level);
  display_on(new_level);
}

ROTARY_DEVICE_DEFINE(0, A0);

void main(void)
{
  enum minode_rotary_level level;
	struct mb_display *disp = mb_display_get();

  printk("mi:node Rotary example starting.\n");
	minode_rotary_init(ROTARY_DEV(0));
  level = minode_rotary_get(ROTARY_DEV(0));
  display_on(level);
  minode_rotary_start_listening(ROTARY_DEV(0));
}
```

## src/sound_example.c
```c
/*
 * Copyright (c) 2017 Intel Corporation
 *
 * SPDX-License-Identifier: Apache-2.0
 */

#include <zephyr.h>
#include <sys/printk.h>
#include <device.h>

#include <display/mb_display.h>
#include <minode.h>

#define SOUND_SENSOR_NAME(id) _CONCAT(sound_, id)
#define SOUND_SENSOR_DEV(id)  (&SOUND_SENSOR_NAME(id))
#define SOUND_SENSOR_DEVICE_DEFINE(id, connector)                           \
				MINODE_SOUND_DEVICE_DEFINE(SOUND_SENSOR_NAME(id), _CONCAT(A, id),   \
				STRINGIFY(id),                                                      \
				sound_on_noise_detect)

static struct mb_image lighting[] = {

  MB_IMAGE({ 0, 0, 0, 0, 0 },
					 { 0, 0, 0, 0, 0 },
					 { 0, 0, 0, 0, 0 },
					 { 0, 0, 0, 0, 0 },
					 { 0, 0, 0, 0, 0 }),

  MB_IMAGE({ 1, 1, 1, 1, 1 },
					 { 1, 1, 1, 1, 1 },
					 { 1, 1, 1, 1, 1 },
					 { 1, 1, 1, 1, 1 },
					 { 1, 1, 1, 1, 1 }),
};

void display_on(int is_noise_detected)
{
  int index;
	struct mb_display *disp = mb_display_get();

  index = is_noise_detected;
  if(index < 0 || index > 1) {
    return;
  }

  mb_display_image(disp, MB_DISPLAY_MODE_SINGLE,
      K_SECONDS(1), &lighting[index], 1);
}

void sound_on_noise_detect(struct minode_sound_device *dev)
{
  const char *id = dev->user_data;
  printk("Light[%s] attached on %s noise detected.\n", id,
      dev->connector);
  display_on(1);
}

SOUND_SENSOR_DEVICE_DEFINE(0, A0);

void main(void)
{
	struct mb_display *disp = mb_display_get();

  printk("mi:node Sound sensor example starting.\n");
	minode_sound_init(SOUND_SENSOR_DEV(0));
  display_on(minode_sound_is_in_noise(SOUND_SENSOR_DEV(0)));
  minode_sound_start_listening(SOUND_SENSOR_DEV(0));
}
```

## src/switch_example.c
```c
/*
 * Copyright (c) 2017 Intel Corporation
 *
 * SPDX-License-Identifier: Apache-2.0
 */

#include <zephyr.h>
#include <sys/printk.h>
#include <drivers/gpio.h>
#include <device.h>

#include <display/mb_display.h>
#include <minode_connector.h>
#include <minode_switch.h>

#define SWITCH_NAME(id) _CONCAT(switch_, id)
#define SWITCH_DEV(id)  (&SWITCH_NAME(id))
#define IS_SWITCH_ON(id) minode_switch_is_on(SWITCH_DEV(id))
#define SWITCH_DEVICE_DEFINE(id, connector)                          \
				MINODE_SWITCH_DEVICE_DEFINE(SWITCH_NAME(id), _CONCAT(A, id), \
				STRINGIFY(id),                                               \
				switch_event_on, switch_event_off)

static struct mb_image smiley = MB_IMAGE({ 0, 1, 0, 1, 0 },
					 { 0, 1, 0, 1, 0 },
					 { 0, 0, 0, 0, 0 },
					 { 1, 0, 0, 0, 1 },
					 { 0, 1, 1, 1, 0 });

void display_on(const char *str)
{
	struct mb_display *disp = mb_display_get();
	mb_display_print(disp, MB_DISPLAY_MODE_SINGLE, K_FOREVER, str);
}

void display_off()
{
	struct mb_display *disp = mb_display_get();
	mb_display_stop(disp);
}

void switch_event_on(struct minode_switch_device *dev)
{
	const char *id = dev->user_data;
	printk("Switch[%s] on.\n", id);
	display_on(id);
}

void switch_event_off(struct minode_switch_device *dev)
{
	const char *id = dev->user_data;
	printk("Switch[%s] off.\n", id);
	display_off();
}

SWITCH_DEVICE_DEFINE(0, A0);
SWITCH_DEVICE_DEFINE(1, A1);

void main(void)
{
	struct mb_display *disp = mb_display_get();

	minode_switch_init(SWITCH_DEV(0));
	minode_switch_init(SWITCH_DEV(1));

	if (IS_SWITCH_ON(0)) {
		display_on(SWITCH_DEV(0)->user_data);
	} else if (IS_SWITCH_ON(1)) {
		display_on(SWITCH_DEV(1)->user_data);
	} else {
		mb_display_image(disp, MB_DISPLAY_MODE_SINGLE,
					K_FOREVER, &smiley, 1);
	}
}
```
